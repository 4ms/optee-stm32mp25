// SPDX-License-Identifier: (GPL-2.0+ OR BSD-3-Clause)
/*
 * Copyright (C) STMicroelectronics 2021 - All Rights Reserved
 * Author: Alexandre Torgue <alexandre.torgue@foss.st.com> for STMicroelectronics.
 */

&rifsc {
	saes: saes@42050000 {
		compatible = "st,stm32mp13-saes";
		reg = <0x42050000 0x400>;
		interrupts = <GIC_SPI 179 IRQ_TYPE_LEVEL_HIGH>;
		clocks = <&rcc CK_BUS_SAES>;
		resets = <&rcc SAES_R>;
		status = "disabled";
	};
};
