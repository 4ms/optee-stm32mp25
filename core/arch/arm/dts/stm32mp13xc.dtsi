// SPDX-License-Identifier: (GPL-2.0+ OR BSD-3-Clause)
/*
 * Copyright (C) STMicroelectronics 2021-2022 - All Rights Reserved
 * Author: Alexandre Torgue <alexandre.torgue@foss.st.com> for STMicroelectronics.
 */

#include "stm32mp13xa.dtsi"

&etzpc {
	cryp: crypto@54002000 {
		compatible = "st,stm32mp1-cryp";
		reg = <0x54002000 0x400>;
		interrupts = <GIC_SPI 80 IRQ_TYPE_LEVEL_HIGH>;
		clocks = <&rcc CRYP1>;
		resets = <&rcc CRYP1_R>;
		status = "disabled";
	};
};

&etzpc {
	saes: saes@54005000 {
		compatible = "st,stm32mp13-saes";
		reg = <0x54005000 0x400>;
		interrupts = <GIC_SPI 82 IRQ_TYPE_LEVEL_HIGH>;
		clocks = <&rcc SAES_K>;
		resets = <&rcc SAES_R>;
		status = "disabled";
	};
};
