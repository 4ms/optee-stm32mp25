## documentation/devicetree/bindings/clock/st,stm32mp1-rcc.yaml
```yaml
# SPDX-License-Identifier: (GPL-2.0-only OR BSD-2-Clause)
%YAML 1.2
---
$id: http://devicetree.org/schemas/clock/st,stm32mp1-rcc.yaml#
$schema: http://devicetree.org/meta-schemas/core.yaml#

title: Reset Clock Controller Binding

maintainers:
  - Gabriel Fernandez <gabriel.fernandez@foss.st.com>

description: |
  The RCC IP is both a reset and a clock controller.
  RCC makes also power management (resume/supend and wakeup interrupt).
  Please also refer to reset.txt for common reset controller binding usage.

  This binding uses common clock bindings
  Documentation/devicetree/bindings/clock/clock-bindings.txt

  Specifying clocks
  =================

  All available clocks are defined as preprocessor macros in
  dt-bindings/clock/stm32mp*-clks.h header and can be used in device
  tree sources.

  Specifying softreset control of devices
  =======================================

  Device nodes should specify the reset channel required in their "resets"
  property, containing a phandle to the reset device node and an index specifying
  which channel to use.
  The index is the bit number within the RCC registers bank, starting from RCC
  base address.
  It is calculated as: index = register_offset / 4 * 32 + bit_offset.
  Where bit_offset is the bit offset within the register.

  For example on STM32MP1, for LTDC reset:
     ltdc = APB4_RSTSETR_offset / 4 * 32 + LTDC_bit_offset
          = 0x180 / 4 * 32 + 0 = 3072

  The list of valid indices for STM32MP1 is available in:
  include/dt-bindings/reset-controller/stm32mp1-resets.h
  include/dt-bindings/reset-controller/stm32mp13-resets.h

  This file implements defines like:
  #define LTDC_R	3072

properties:
  "#address-cells":
    const: 1

  "#size-cells":
    const: 0

  "#clock-cells":
    const: 1

  "#reset-cells":
    const: 1

  compatible:
    items:
      - enum:
          - st,stm32mp1-rcc-secure
          - st,stm32mp1-rcc
          - st,stm32mp13-rcc
      - const: syscon

  reg:
    maxItems: 1

  st,clkdiv:
    description: Clock divisions used for dividers configuration, mandatory for MP13
    minItems: 1

  st,clksrc:
    description: Clock sources used for mux configuration, mandatory for MP13
    minItems: 1

  st,rcc:
    type: object

    properties:
      compatible:
        const: st,rcc

      clocks:
        description: >
          List of phandles for clocks activated by RCC himself.
          This properties allows to set always on clocks for clocks, used by
          RCC subsystem or required by the board.
        minItems: 1

      pinctrl-0:
        description: >
          Describes the default pin control associated to the RCC subsystem.
          Contains the pinmux and the bias config.
          This properties can be used, for example, to configure an MCO clock
          output through an output pin.
        minItems: 1

       additionalProperties: false

patternProperties:
  '^st,pll@[0-9]*$':
    type: object
    properties:
      compatible:
        const: st,stm32mp1-pll

      reg:
        minItems: 1

      cfg:
        minItems: 1

      frac:
        minItems: 1

      if:
        compatible:
          items:
            - enum:
              st,stm32mp13-rcc
      then:
        pll_cfg:
          '^pll[0-9]_cfg[0-9]$':
            type: object

            st,pll_vco:
              minItems: 1

            st,pll_div_pqr:
              minItems: 1

            required:
              - st,pll_vco

    required:
      - compatible

if:
  properties:
    compatible:
      - st,stm32mp13-rcc
then:
  required:
    - clocks

required:
  - "#address-cells"
  - "#size-cells"
  - "#clock-cells"
  - "#reset-cells"
  - compatible
  - reg
  - st,clkdiv
  - st,clksrc

additionalProperties: false

examples:
  - |
    //SOC level
    rcc: rcc@50000000 {
      compatible = "st,stm32mp1-rcc-secure", "st,stm32mp1-rcc", "syscon";
      reg = <0x50000000 0x1000>;
      #address-cells = <1>;
      #size-cells = <0>;
      #clock-cells = <1>;
      #reset-cells = <1>;
      interrupts = <GIC_SPI 5 IRQ_TYPE_LEVEL_HIGH>;
      secure-interrupts = <GIC_SPI 145 IRQ_TYPE_LEVEL_HIGH>;
      secure-interrupt-names = "wakeup";
    };

    //board level
    &rcc {
      st,clksrc = <
        CLK_MPU_PLL1P
        CLK_AXI_PLL2P
        CLK_MCU_PLL3P
        CLK_PLL12_HSE
        CLK_PLL3_HSE
        CLK_PLL4_HSE
        CLK_RTC_LSE
        CLK_MCO1_DISABLED
        CLK_MCO2_DISABLED
      >;

      st,clkdiv = <
        1 /*MPU*/
        0 /*AXI*/
        0 /*MCU*/
        1 /*APB1*/
        1 /*APB2*/
        1 /*APB3*/
        1 /*APB4*/
        2 /*APB5*/
        23 /*RTC*/
        0 /*MCO1*/
        0 /*MCO2*/
      >;

      st,pkcs = <
        CLK_CKPER_HSE
        CLK_FMC_ACLK
        CLK_QSPI_ACLK
        CLK_ETH_PLL4P
        CLK_SDMMC12_PLL4P
        CLK_DSI_DSIPLL
        CLK_STGEN_HSE
        CLK_USBPHY_HSE
        CLK_SPI2S1_PLL3Q
        CLK_SPI2S23_PLL3Q
        CLK_SPI45_HSI
        CLK_SPI6_HSI
        CLK_I2C46_HSI
        CLK_SDMMC3_PLL4P
        CLK_USBO_USBPHY
        CLK_ADC_CKPER
        CLK_CEC_LSE
        CLK_I2C12_HSI
        CLK_I2C35_HSI
        CLK_UART1_HSI
        CLK_UART24_HSI
        CLK_UART35_HSI
        CLK_UART6_HSI
        CLK_UART78_HSI
        CLK_SPDIF_PLL4P
        CLK_FDCAN_PLL4R
        CLK_SAI1_PLL3Q
        CLK_SAI2_PLL3Q
        CLK_SAI3_PLL3Q
        CLK_SAI4_PLL3Q
        CLK_RNG1_CSI
        CLK_RNG2_LSI
        CLK_LPTIM1_PCLK1
        CLK_LPTIM23_PCLK3
        CLK_LPTIM45_LSE
      >;

      /* VCO = 1066.0 MHz => P = 266 (AXI), Q = 533 (GPU), R = 533 (DDR) */
      pll2: st,pll@1 {
        compatible = "st,stm32mp1-pll";
        reg = <1>;
        cfg = <2 65 1 0 0 PQR(1,1,1)>;
        frac = <0x1400>;
      };

      /* VCO = 417.8 MHz => P = 209, Q = 24, R = 11 */
      pll3: st,pll@2 {
        compatible = "st,stm32mp1-pll";
        reg = <2>;
        cfg = <1 33 1 16 36 PQR(1,1,1)>;
        frac = <0x1a04>;
      };

      /* VCO = 594.0 MHz => P = 99, Q = 74, R = 74 */
      pll4: st,pll@3 {
        compatible = "st,stm32mp1-pll";
        reg = <3>;
        cfg = <3 98 5 7 7 PQR(1,1,1)>;
      };
    };
...
```

## documentation/devicetree/bindings/hwmon/st,stm32-tamp.yaml
```yaml
# SPDX-License-Identifier: (GPL-2.0-only OR BSD-2-Clause)
%YAML 1.2
---
$id: http://devicetree.org/schemas/hwmon/st,stm32-tamp.yaml#
$schema: http://devicetree.org/meta-schemas/core.yaml#

title: STMicroelectronics STM32 Tamper bindings

maintainers:
  - Nicolas Toromanoff <nicolas.toromanoff@st.com>

properties:
  compatible:
    enum:
      - st,stm32-tamp
      - st,stm32mp13-tamp

  reg:
    maxItems: 1

  clocks:
    maxItems: 1

  interrupts:
    maxItems: 1

  st,tamp_passive_precharge:
    description: 0 is no precharge, so the pull-up is disabled for all external passive tamper.
       1, 2, 3, 4, 8 define the number of cycle the STM32 precharge the pin before
       checking the value (low/high) for all external tamper.
    $ref: /schemas/types.yaml#/definitions/uint32
    enum: [0, 1, 2, 4, 8]

  st,tamp_passive_nb_sample:
    description: The number of sample to read in a row to raise a passive tamper.
    $ref: /schemas/types.yaml#/definitions/uint32
    enum: [0, 2, 4, 8]

  st,tamp_passive_sample_clk_div:
    description: Clock divider to define frequency to read a sample for a passive tamper.
    $ref: /schemas/types.yaml#/definitions/uint32

  st,tamp_active_filter:
    description: Set the active tamper filtering. 0 when active tamper filtering is disabled.
      1 when active tamper filtering is enabled. A tamper event is detected when 2 comparison
      mismatches occur out of 4 consecutive samples.
    $ref: /schemas/types.yaml#/definitions/uint32
    enum: [0, 1]

  st,tamp_active_clk_div:
    description: clock divider to define the frequency of read/write cycle for all active tampers.
    $ref: /schemas/types.yaml#/definitions/uint32

  st,trig_on:
    description: Defines the active level to activate this passive tamper
      (not used if pintctrl-0 as 2 entries).
      It also depends on st,tamp_passive_precharge value. When st,tamp_passive_precharge=0
      this passive tamper activate at edge. When st,tamp_passive_precharge != 0, with st,trig_on
      defined, this passive tamper will activate if st,tamp_passive_nb_sample in a row are high.
      If not defined the passive tamper event is raised if st,tamp_passive_nb_sample in a row
      are low.
    type: boolean

patternProperties:
  "^tamp_passive@[0-9]+$":
    description: Describe the passive tamper with its allocated pinctrl.
    type: object

  "^tamp_active@[0-9]+$":
    type: object
    description:
            Describe the active tamper with its allocated pinctrl.

required:
  - compatible
  - reg
  - clocks

additionalProperties: false

examples:
  - |
    #include <dt-bindings/clock/stm32mp1-clks.h>
    #include <dt-bindings/reset/stm32mp1-resets.h>
    tamp: tamp@5c00a000 {
            compatible = "st,stm32mp13-tamp";
            reg = <0x5c00a000 0x400>;
            interrupts = <GIC_SPI 128 IRQ_TYPE_LEVEL_HIGH>;
            clocks = <&rcc RTCAPB>;
    };
...
```
